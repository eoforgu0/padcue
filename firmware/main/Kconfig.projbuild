## firmware/main/Kconfig.projbuild
```kconfig
menu "pademu"

config PADEMU_WIFI_SSID
    string "WiFi SSID (NVS 未設定時のフォールバック)"
    default ""

config PADEMU_WIFI_PASS
    string "WiFi パスワード (同上)"
    default ""

config PADEMU_USB_BINTERVAL
    int "USB IN エンドポイントの bInterval (ms)"
    range 1 16
    default 1
    help
        1 = 1ms ポーリング(入力反映の不確かさを 5ms から 1ms へ低減)。
        実在の Pro コントローラーは 8。Switch が 1 を受け入れない場合は
        8 に戻す(設計文書 7.3-1 / 未検証事項1)。

choice PADEMU_TRANSPORT_DEFAULT
    prompt "起動時の転送層モード(NVS 未設定時)"
    default PADEMU_TRANSPORT_PROCON
    config PADEMU_TRANSPORT_PROCON
        bool "Pro コントローラー方式(本命・ジャイロ可)"
    config PADEMU_TRANSPORT_HIDPAD
        bool "HID ゲームパッド方式(保険・ジャイロ不可)"
endchoice

endmenu
```

## firmware/sdkconfig.defaults
```kconfig
CONFIG_IDF_TARGET="esp32s3"

# フラッシュ 8MB(ESP32-S3FN8)
CONFIG_ESPTOOLPY_FLASHSIZE_8MB=y

# パーティション(OTA A/B + procs)
CONFIG_PARTITION_TABLE_CUSTOM=y
CONFIG_PARTITION_TABLE_CUSTOM_FILENAME="partitions.csv"

# OTA ロールバック(起動セルフテスト通過まで新版を確定しない)
CONFIG_BOOTLOADER_APP_ROLLBACK_ENABLE=y

# 1ms tick(タイミング系の分解能)
CONFIG_FREERTOS_HZ=1000

CONFIG_ESP_MAIN_TASK_STACK_SIZE=8192

# USB-OTG(TinyUSB)。HID デバイス1個
CONFIG_TINYUSB_HID_COUNT=1
CONFIG_TINYUSB_CDC_ENABLED=n
CONFIG_TINYUSB_MSC_ENABLED=n
# TinyUSB のタスクを自前で回す(イベント処理と送出を1タスクに統合し、
# 応答キューと転送層状態への並行アクセスを構造的に排除する)
CONFIG_TINYUSB_NO_DEFAULT_TASK=y
CONFIG_TINYUSB_INIT_IN_DEFAULT_TASK=n

# GPTimer の ISR をフラッシュキャッシュ無効中も動かす(実行エンジンの必須設定)
CONFIG_GPTIMER_ISR_IRAM_SAFE=y
CONFIG_GPTIMER_CTRL_FUNC_IN_IRAM=y

# WiFi 設定を NVS へ書かせない(実行中の暗黙のフラッシュ書き込みを排除)
CONFIG_ESP_WIFI_NVS_ENABLED=n

# 手順名 32 バイト + "/procs/" + ".bin" が収まるファイル名長(既定 32 では不足)
CONFIG_SPIFFS_OBJ_NAME_LEN=48

# クラッシュしたときに「どこで落ちたか」をフラッシュへ残す。
# これが無効だと、実行中のパニックを追うのに逆アセンブル解析が要る。
# 有効にしておけば padcue で吸い出して原因を直接見られる
CONFIG_ESP_COREDUMP_ENABLE_TO_FLASH=y
CONFIG_ESP_COREDUMP_DATA_FORMAT_ELF=y
CONFIG_ESP_COREDUMP_CHECKSUM_CRC32=y
CONFIG_ESP_COREDUMP_STACK_SIZE=1280
```
